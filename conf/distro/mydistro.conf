## conf/distro/mydistro.conf
```bitbake
require conf/distro/poky.conf

DISTRO = "mydistro"
DISTRO_NAME = "MyDistro (A distro for Jetson Nano board)"
DISTRO_VERSION = "1.0.0"
DISTRO_CODENAME = "dunfell"
SDK_VENDOR = "-mydistro"
SDK_VERSION = "${@d.getVar('DISTRO_VERSION').replace('snapshot-${DATE}', 'snapshot')}"

MAINTAINER = "Mauricio <mauriciovanegash@gmail.com>"

TARGET_VENDOR = "-mydistro"

LOCALCONF_VERSION = "1"

DISTRO_VERSION[vardepsexclude] = "DATE"
SDK_VERSION[vardepsexclude] = "DATE"

PREFERRED_VERSION_python3 = "3.8%"
PREFERRED_VERSION_python3-native = "3.8%"

# TensorRT packages
NVIDIA_DEVNET_MIRROR="file:///home/mauricio/nvidia/sdkm_downloads"

#Cuda support for gcc
GCCVERSION = "8.%"

DISTRO_FEATURES_append = " ldconfig virtualization systemd x11 gtk"
DISTRO_FEATURES_BACKFILL_CONSIDERED += "sysvinit"
VIRTUAL-RUNTIME_init_manager = "systemd"
VIRTUAL-RUNTIME_initscripts = "systemd-compat-units"
PACKAGECONFIG_pn-opencv = "python3 eigen jpeg png tiff v4l libv4l gstreamer gtk"

# GCC 7 doesn't support fmacro-prefix-map, results in "error: cannot compute suffix of object files: cannot compile"
# Change the value from bitbake.conf DEBUG_PREFIX_MAP to remove -fmacro-prefix-map
DEBUG_PREFIX_MAP = "-fdebug-prefix-map=${WORKDIR}=/usr/src/debug/${PN}/${EXTENDPE}${PV}-${PR} \
                    -fdebug-prefix-map=${STAGING_DIR_HOST}= \
                    -fdebug-prefix-map=${STAGING_DIR_NATIVE}= \
                    "
```
